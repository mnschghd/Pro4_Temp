## ESP32S3/main/Kconfig.projbuild
```kconfig
menu "ESP32S3-WebDrive"

    comment "WiFi SSID and password are configured in main/webdrive_config.h"

    config WEBDRIVE_MAX_UPLOAD_SIZE_KB
        int "Maximum upload file size (KB)"
        default 4096
        range 1 32768
        help
            Files larger than this are rejected at upload time.
            (Also set WEBDRIVE_MAX_UPLOAD_SIZE in webdrive_config.h)

    config WEBDRIVE_SPIFFS_MAX_FILES
        int "Max open files on SPIFFS"
        default 5
        range 2 10
        help
            Simultaneous open file descriptors.

endmenu
```

## ESP32S3/sdkconfig.defaults
```kconfig
# ESP32-S3 target
CONFIG_IDF_TARGET="esp32s3"

# Partition table
CONFIG_PARTITION_TABLE_CUSTOM=y
CONFIG_PARTITION_TABLE_CUSTOM_FILENAME="partitions.csv"
CONFIG_PARTITION_TABLE_FILENAME="partitions.csv"

# SPIFFS
CONFIG_SPIFFS_USE_MAGIC=y
CONFIG_SPIFFS_USE_MAGIC_LENGTH=y
CONFIG_SPIFFS_META_LENGTH=4
CONFIG_SPIFFS_CACHE=y
CONFIG_SPIFFS_CACHE_WR=y

# HTTP server
CONFIG_HTTPD_MAX_REQ_HDR_LEN=512
CONFIG_HTTPD_MAX_URI_LEN=512

# Logging
CONFIG_LOG_DEFAULT_LEVEL_INFO=y

# Flash size (YD-ESP32-23 has 16 MB)
CONFIG_ESPTOOLPY_FLASHSIZE_4MB=y

# WiFi
CONFIG_ESP_WIFI_SOFTAP_BEACON_MAX_LEN=752
```
